## query-service/main/Kconfig.projbuild
```kconfig
menu "Application Configuration"

  config ESP_WIFI_SSID
		string "WiFi SSID"
		default "myssid"
		help
			SSID (network name) for the example to connect to.

	config ESP_WIFI_PASSWORD
		string "WiFi Password"
		default "mypassword"
		help
			WiFi password (WPA or WPA2) for the example to use.

	config ESP_MAXIMUM_RETRY
		int "Maximum retry"
		default 5
		help
			Set the Maximum retry to avoid station reconnecting to the AP unlimited when the AP is really inexistent.

	config UDP_PORT
		int "UDP Port Number"
		range 49152 65535
		default 49876
		help
			Communication UDP port number

	config MDNS_TXT
		bool "Use mDNS TXT Record"
		default false
		help
			Use mDNS TXT Record.

	config MDNS_INSTANCE
		string
		default "ESP32 with mDNS"

	config MDNS_HOSTNAME
		string
		default "esp32-mdns"

endmenu
```
